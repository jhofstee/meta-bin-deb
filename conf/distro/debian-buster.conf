## conf/distro/debian-buster.conf
```bitbake
DISTRO = "debian-buster"
DISTRO_NAME = "debian"
DISTRO_VERSION = "buster"

include conf/distro/include/debian-common.inc

DISTRO_FEATURES = " \
	usbhost \
	usbgadget \
	opengl \
	wifi \
	${DISTRO_FEATURES_LIBC} \
	x11 \
"

DEB_SOURCES = "deb http://ftp.de.debian.org/debian buster main"

# see http://packages.ubuntu.com/trusty/python-argparse
DEBIANNAME_python-argparse = "libpython2.7-stdlib"

# use the stdc++ library of the target
PROVIDES_append_pn-gcc-8 = " virtual/${TARGET_PREFIX}compilerlibs"
PREFERRED_PROVIDER_virtual/${TARGET_PREFIX}compilerlibs = "gcc-8"
```

## conf/distro/debian-jessie.conf
```bitbake
DISTRO = "debian-jessie"
DISTRO_NAME = "debian"
DISTRO_VERSION = "jessie"

include conf/distro/include/debian-common.inc

DISTRO_FEATURES = " \
	usbhost \
	usbgadget \
	opengl \
	wifi \
	${DISTRO_FEATURES_LIBC} \
	x11 \
"

DEB_SOURCES = "deb http://ftp.de.debian.org/debian jessie main"

# see http://packages.ubuntu.com/trusty/python-argparse
DEBIANNAME_python-argparse = "libpython2.7-stdlib"

# use the stdc++ library of the target
PROVIDES_append_pn-gcc-4.8 = " virtual/${TARGET_PREFIX}compilerlibs"
PREFERRED_PROVIDER_virtual/${TARGET_PREFIX}compilerlibs = "gcc-4.8"
```

## conf/distro/include/debian-common.inc
```bitbake
PACKAGE_CLASSES ?= "package_deb"
DISTRO = "${DISTRO_NAME}-${DISTRO_VERSION}"

SANITY_TESTED_DISTROS = " \
	ubuntu-16.04 \n \
	ubuntu-18.04 \n \
"

WARN_QA = ""
ERROR_QA = "dev-so debug-deps dev-deps debug-files arch la2 pkgconfig la perms useless-rpaths rpaths staticdev"

# blacklist blacklist_src_packages
INHERIT += "deb_feed"

PKG_CONFIG_PATH_class-target .= ":${PKG_CONFIG_SYSROOT_DIR}/${libdir}/${EXTERNAL_TARGET_SYS}/pkgconfig"

CONNECTIVITY_CHECK_URIS ?= ""

# Debian doesn't split python like OE does, so point them to python itself..
DEBIANNAME_python-fcntl = "python"
DEBIANNAME_python-core = "python"
DEBIANNAME_python-datetime = "python"
DEBIANNAME_python-email = "python"
DEBIANNAME_python-compression = "python"
DEBIANNAME_python-io = "python"
DEBIANNAME_python-json = "python"
DEBIANNAME_python-multiprocessing = "python"
DEBIANNAME_python-netserver = "python"
DEBIANNAME_python-pprint = "python"
DEBIANNAME_python-pyserial = "python-serial"
DEBIANNAME_python-shell = "python"
DEBIANNAME_python-sqlite3 = "python"
DEBIANNAME_python-subprocess = "python"
DEBIANNAME_python-pygobject = "python-gobject"

DEBIANNAME_python3-core = "python3"
DEBIANNAME_python3-fcntl = "python3"
DEBIANNAME_python3-io = "python3"
DEBIANNAME_python3-json = "python3"
DEBIANNAME_python3-multiprocessing = "python3"
DEBIANNAME_python3-pprint = "python3"
DEBIANNAME_python3-pygobject = "python3-gi"
DEBIANNAME_python3-pyserial = "python3-serial"
DEBIANNAME_python3-shell = "python3"
DEBIANNAME_python3-sqlite3 = "python3"

DEBIANNAME_bluez5 = "bluez"

# runtime packages
DEBIANNAME_glibc-gconv-iso8859-1 = "libc6"

DEBIANNAME_glib-2.0 = "glib2.0"
DEBIANNAME_libsoup-2.4 = "libsoup2.4"

UPDATERCD = "sysv-rc"
PROVIDES_append_pn-sysvinit = " update-rc.d"

PREFERRED_PROVIDER_python-lxml = "lxml"
PREFERRED_PROVIDER_python-pymodbus = "pymodbus"
PREFERRED_PROVIDER_python-requests = "requests"

PREFERRED_VERSION_openssl_forcevariable = ""

DAEMONTOOLS = "daemontools-run"
RPROVIDES_daemontools_append_pn-daemontools = "daemontools-run-dev"
DAEMONTOOLS_SERVICES_DIR = "/etc/service"
PREFERRED_PROVIDER_daemontools-run = "daemontools-run"
```

## conf/distro/include/tcmode-external-debian.inc
```bitbake
include conf/distro/include/tcmode-external.inc

PREFERRED_PROVIDER_virtual/${TARGET_PREFIX}libc-for-gcc = "glibc-deb"
PREFERRED_PROVIDER_virtual/${TARGET_PREFIX}libc-initial = "glibc-deb"
PREFERRED_PROVIDER_glibc = "glibc-deb"
PREFERRED_PROVIDER_virtual/libc = "glibc-deb"
PREFERRED_PROVIDER_virtual/libintl = "glibc-deb"
PREFERRED_PROVIDER_virtual/libiconv = "glibc-deb"

PROVIDES_append_pn-glibc-deb = " virtual/libc virtual/${TARGET_PREFIX}libc-for-gcc"
PROVIDES_append_pn-glibc = " virtual/libc virtual/${TARGET_PREFIX}libc-for-gcc"
```

## conf/distro/raspbian-buster.conf
```bitbake
DISTRO_VERSION = "buster"

include conf/distro/raspbian.conf

DEB_SOURCES = "deb http://archive.raspbian.org/raspbian buster main contrib non-free"

# see http://packages.ubuntu.com/trusty/python-argparse
DEBIANNAME_python-argparse = "libpython2.7-stdlib"

# use the stdc++ library of the target
PROVIDES_append_pn-gcc-8 = " virtual/${TARGET_PREFIX}compilerlibs"
PREFERRED_PROVIDER_virtual/${TARGET_PREFIX}compilerlibs = "gcc-8"
```

## conf/distro/raspbian-jessie.conf
```bitbake
DISTRO_VERSION = "jessie"

include conf/distro/raspbian.conf

DEB_SOURCES = "deb http://archive.raspbian.org/raspbian jessie main contrib non-free"

# see http://packages.ubuntu.com/trusty/python-argparse
DEBIANNAME_python-argparse = "libpython2.7-stdlib"

# use the stdc++ library of the target
PROVIDES_append_pn-gcc-4.8 = " virtual/${TARGET_PREFIX}compilerlibs"
PREFERRED_PROVIDER_virtual/${TARGET_PREFIX}compilerlibs = "gcc-4.8"
```

## conf/distro/raspbian-wheezy.conf
```bitbake
DISTRO_VERSION = "wheezy"

include conf/distro/raspbian.conf

DEB_SOURCES = "deb http://archive.raspbian.org/raspbian wheezy main contrib non-free"

# the binary libc6-dev will install all of these, since it doesn't need to bootstrap the compiler nor libc
PROVIDES_append_pn-eglibc = " virtual/libc virtual/${TARGET_PREFIX}libc-for-gcc"
PREFERRED_PROVIDER_virtual-libc ?= "eglibc"
PREFERRED_PROVIDER_virtual/${TARGET_PREFIX}libc-for-gcc ?= "${PREFERRED_PROVIDER_virtual-libc}"
PREFERRED_PROVIDER_virtual/${TARGET_PREFIX}libc-initial ?= "${PREFERRED_PROVIDER_virtual-libc}"
PREFERRED_PROVIDER_linux-libc-headers ?= "linux-libc-headers"

# use the stdc++ library of the target
PROVIDES_append_pn-gcc-4.4 = " virtual/${TARGET_PREFIX}compilerlibs"
PREFERRED_PROVIDER_virtual/${TARGET_PREFIX}compilerlibs ?= "gcc-4.4"

# note: depends on the toolchain!
TARGET_VENDOR = ""

TOOLCHAIN_OPTIONS += "-I ${STAGING_DIR_TARGET}/usr/include/c++/4.4"
TOOLCHAIN_OPTIONS += "-I ${STAGING_DIR_TARGET}/usr/include/c++/4.4/${TARGET_SYS}"
```

## conf/distro/raspbian.conf
```bitbake
DISTRO_NAME = "raspbian"
DISTRO_VERSIONS = "wheezy jessie"

include conf/distro/include/debian-common.inc

DISTRO_FEATURES = " \
	usbhost \
	usbgadget \
	opengl \
	wifi \
	${DISTRO_FEATURES_LIBC} \
	x11 \
"
```

## conf/layer.conf
```bitbake
# add conf and classes directory to BBPATH
BBPATH := "${BBPATH}:${LAYERDIR}"

# add the recipes to BBFILES
BBFILES := "${BBFILES} \
	${LAYERDIR}/meta-generated/${DISTRO}/*.bb \
"

BBFILES += "${LAYERDIR}/recipes*/*/*.bb ${LAYERDIR}/recipes*/*/*.bbappend"

BBFILE_COLLECTIONS += "meta-bin-deb"
BBFILE_PATTERN_meta-bin-deb := "^${LAYERDIR}/"
BBFILE_PRIORITY_meta-bin-deb = "30"

LAYERSERIES_COMPAT_meta-bin-deb = "zeus"
```

## conf/machine/debian-armel.conf
```bitbake
# generic debian armel machine, not tuned at all, no fpu etc
require conf/machine/include/arm/arch-armv4.inc
```

## conf/machine/debian-armhf.conf
```bitbake
DEFAULTTUNE ?= "armv7athf-neon"
require conf/machine/include/arm/arch-armv7a.inc
```
